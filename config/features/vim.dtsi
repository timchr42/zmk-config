/*
*
* Copyright (c) 2025 Rafael Romão
* SPDX-License-Identifier: MIT
*
*/

#include <dt-bindings/zmk/hid_usage.h>


/ {
    hid_listeners {
        compatible = "zmk,hid-listeners";

        num_lock {           
            indicator = <HID_USAGE_LED_NUM_LOCK>;
            bindings = <&vim_reset &vim_off>; // num lock on -> vim mode on
        };
    };
};

/*  HELPER MACROS  */

#define VIM_MACRO(NAME, BINDINGS) \
    NAME: NAME { \
        compatible = "zmk,behavior-macro"; \
        #binding-cells = <0>; \
        wait-ms = <5>; \
        tap-ms = <5>; \
        bindings = <BINDINGS>; \
    };

#define VIM_BINDING( \
        NAME, \
        LAYERS, \
        MORPHED_BINDING, \
        DEFAULT_BINDING \
    ) \
    NAME: NAME { \
        compatible = "zmk,behavior-layer-morph"; \
        #binding-cells = <0>; \
        layers = <LAYERS>; \
        bindings \
            = <DEFAULT_BINDING> \
            , <MORPHED_BINDING> \
            ; \
    };

#define VIM_MOD_MORPH(NAME, MODS, MODDED, UNMODDED) \
    NAME: NAME { \
        compatible = "zmk,behavior-mod-morph"; \
        #binding-cells = <0>; \
        bindings = <UNMODDED>, <MODDED>; \
        mods = <(MODS)>; \
        keep-mods = <(MODS)>; \
    };

/ {
    vim {

        VIM_MACRO(vim_off               , &tog_off VIM_NORMAL &tog_off VIM_CHANGE &tog_off VIM_VISUAL &tog_off VIM_INSERT &tog_off VIM_REPLACE &tog_off VIM_LEADER &tog_off VIM_CMDLINE)
        VIM_MACRO(vim_reset             , &vim_off &tog_on VIM_NORMAL &kp ESC)
        VIM_MACRO(vim_normal            , &vim_off &tog_on VIM_NORMAL)
        VIM_MACRO(vim_insert            , &vim_off &tog_on VIM_INSERT)
        VIM_MACRO(vim_cmdline           , &vim_off &tog_on VIM_CMDLINE)
        VIM_MACRO(vim_leader            , &vim_off &tog_on VIM_LEADER)
        VIM_MACRO(vim_replace           , &ntsl VIM_REPLACE)

        VIM_MACRO(vim_space_lead        , &vim_leader &kp SPACE)

        VIM_MACRO(vim_slash             , &vim_cmdline &kp DE_SLASH)

        VIM_MACRO(vim_colon             , &vim_cmdline &kp DE_COLON)
        VIM_BINDING(lm_colon_vim        , VIM_NORMAL VIM_VISUAL VIM_CHANGE, &vim_colon, &kp DE_COLON)

        VIM_MACRO(vim_enter             , &vim_normal &kp ENTER)
        VIM_BINDING(lm_ent_vim          , VIM_CMDLINE, &vim_enter, &kp ENTER)

        VIM_MACRO(vim_esc               , &vim_normal &kp ESC)
        VIM_BINDING(lm_esc_vim          , VIM_VISUAL VIM_CHANGE VIM_LEADER VIM_INSERT VIM_REPLACE VIM_CMDLINE, &vim_esc, &kp ESC)

        VIM_MACRO(vim_o                 , &kp O &tog_off VIM_NORMAL &tog_off VIM_VISUAL &tog_on VIM_INSERT)
        VIM_MACRO(vim_a                 , &kp A &tog_off VIM_NORMAL &tog_off VIM_VISUAL &tog_on VIM_INSERT)
        VIM_MACRO(vim_i                 , &kp I &tog_off VIM_NORMAL &tog_off VIM_VISUAL &tog_on VIM_INSERT)
        VIM_MACRO(vim_ca                , &kp A &ntsl VIM_CHANGE)
        VIM_MACRO(vim_ci                , &kp I &ntsl VIM_CHANGE)
        VIM_MACRO(vim_c                 , &kp C &tog_off VIM_NORMAL &tog_off VIM_VISUAL &tog_on VIM_INSERT &ntsl VIM_CHANGE)
        VIM_MACRO(vim_s                 , &kp S &tog_off VIM_NORMAL &tog_off VIM_VISUAL &ntsl VIM_NORMAL &tog_on VIM_INSERT)
        VIM_MACRO(vim_r                 , &kp R &vim_replace)

        VIM_MACRO(vim_sft_c             , &kp C &tog_off VIM_NORMAL &tog_on VIM_INSERT)
        VIM_MOD_MORPH(mm_sft_c_vim      , MOD_LSFT|MOD_RSFT, &vim_sft_c, &vim_c)

        VIM_MOD_MORPH(vim_a_ctrl_a      , MOD_LCTL|MOD_RCTL, &kp DE_A, &vim_a)
        VIM_MOD_MORPH(vim_i_ctrl_i      , MOD_LCTL|MOD_RCTL, &kp DE_I, &vim_i)
        VIM_MOD_MORPH(vim_o_ctrl_o      , MOD_LCTL|MOD_RCTL, &kp DE_O, &vim_o)
        VIM_MOD_MORPH(vim_s_ctrl_s      , MOD_LCTL|MOD_RCTL, &kp DE_S, &vim_s)
        VIM_MOD_MORPH(vim_s_alt_s       , MOD_LALT|MOD_RALT, &kp DE_S, &vim_s)
        VIM_MOD_MORPH(vim_r_ctrl_r      , MOD_LCTL|MOD_RCTL, &kp DE_R, &vim_r)
        VIM_MOD_MORPH(vim_c_ctrl_c      , MOD_LCTL|MOD_RCTL, &kp DE_C &vim_reset, &mm_sft_c_vim)

        VIM_MOD_MORPH(mm_ent_vim        , MOD_ALL, &lm_ent_vim , &kp ENTER)
        VIM_MOD_MORPH(mm_esc_vim        , MOD_ALL, &lm_esc_vim , &kp ESC)
        

        // VISUAL MODE EXITS

        VIM_MACRO(mc_c_visual_vim       , &kp C &tog_off VIM_VISUAL &tog_on VIM_INSERT)
        VIM_BINDING(lm_c_vim            , VIM_VISUAL, &mc_c_visual_vim , &vim_c_ctrl_c)

        VIM_MACRO(mc_v_vim              , &kp V &tog_on VIM_VISUAL)
        VIM_BINDING(lm_v_vim            , VIM_VISUAL, &vim_normal , &mc_v_vim)

        VIM_MACRO(mc_sft_v_vim          , &vim_reset &tog_on VIM_VISUAL &kp LS(V))
        VIM_BINDING(lm_sft_v_vim        , VIM_VISUAL, &vim_normal , &mc_sft_v_vim)

        VIM_MACRO(mc_ctl_v_vim          , &vim_reset &tog_on VIM_VISUAL &kp LC(V))
        VIM_BINDING(lm_ctl_v_vim        , VIM_VISUAL, &vim_normal , &mc_ctl_v_vim)

        VIM_MACRO(vim_x                 , &vim_normal &kp DE_X)
        VIM_BINDING(lm_x_vim            , VIM_VISUAL, &vim_x, &kp DE_X)

        VIM_MACRO(vim_d                 , &vim_normal &kp DE_D)
        VIM_BINDING(lm_d_vim            , VIM_VISUAL, &vim_d, &kp DE_D)

        VIM_MACRO(vim_y                 , &vim_normal &kp DE_Y)
        VIM_BINDING(lm_y_vim            , VIM_VISUAL, &vim_y, &kp DE_Y)

        VIM_MACRO(vim_p                 , &vim_normal &kp DE_P)
        VIM_BINDING(lm_p_vim            , VIM_VISUAL, &vim_p, &kp DE_P)

        VIM_MACRO(vim_sft_j             , &vim_normal &kp DE_J)
        VIM_MOD_MORPH(mm_sft_j_vim      , MOD_LSFT|MOD_RSFT, &vim_sft_j, &kp DE_J)

        VIM_MACRO(vim_eql               , &vim_normal &kp DE_EQUAL)
        VIM_BINDING(lm_eql_vim          , VIM_VISUAL, &vim_eql, &kp DE_EQUAL)

        VIM_MACRO(vim_tilde             , &vim_normal &kp DE_TILDE)
        VIM_BINDING(lm_tilde_vim        , VIM_VISUAL, &vim_tilde, &kp DE_TILDE)

        VIM_MACRO(vim_excl              , &vim_cmdline &kp DE_EXCL)
        VIM_BINDING(lm_excl_vim         , VIM_VISUAL, &vim_excl, &kp DE_EXCL)

        VIM_MACRO(vim_q                 , &kp DE_Q &vim_replace)
        VIM_BINDING(lm_q_vim            , VIM_NORMAL VIM_VISUAL, &vim_q, &kp DE_Q)

        VIM_MACRO(vim_at                , &kp DE_AT &vim_replace)
        VIM_BINDING(lm_at_vim           , VIM_NORMAL VIM_VISUAL, &vim_at, &kp DE_AT)
    };
};
