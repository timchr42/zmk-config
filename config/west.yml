## config/west.yml
```yaml
manifest:
  remotes:
    - name: zmkfirmware
      url-base: https://github.com/zmkfirmware

    - name: caksoylar
      url-base: https://github.com/caksoylar
    - name: englmaxi
      url-base: https://github.com/englmaxi
    - name: rafaelromao
      url-base: https://github.com/rafaelromao
    - name: ssbb
      url-base: https://github.com/ssbb
    - name: urob
      url-base: https://github.com/urob

    #- name: charlesmst
    #  url-base: https://github.com/charlesmst
  projects:
    - name: zmk
      remote: zmkfirmware
      revision: main

    - name: zmk
      remote: caksoylar
      revision: main
      path: modules/caksoylar/zmk

    - name: zmk-dongle-display
      remote: englmaxi
      revision: main
      path: modules/englmaxi/zmk-dongle-display

    - name: zmk-layer-morph
      remote: rafaelromao
      revision: main
      path: modules/rafaelromao/zmk-layer-morph

    - name: zmk-listeners
      remote: ssbb
      revision: main
      path: modules/ssbb/zmk-listeners

    - name: zmk-adaptive-key
      remote: urob
      revision: main
      path: modules/urob/zmk-adaptive-key

    - name: zmk-auto-layer
      remote: urob
      revision: main
      path: modules/urob/zmk-auto-layer

    - name: zmk-leader-key
      remote: urob
      revision: main
      path: modules/urob/zmk-leader-key

    #- name: zmk-pmw3610-driver
    #  remote: charlesmst
    #  revision: main
  self:
    path: config
```
